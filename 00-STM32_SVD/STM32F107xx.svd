# STM32F107xx register map
File version: 1.2
Registers are 32-bit, read-write, reset 0x0 unless marked. A register's access mark holds for its fields unless they carry their own. Offsets are from the block's base; lines under a group give offsets from that group; [hi:lo] are bit positions; {n}, {i} and the like mark numbered series; 'fields as' and 'values as' point back to an identical list; <NAME> marks a mode.

## Memory map
0x40000000 TIM2 size 0x400 — General purpose timer
0x40000400 TIM3 size 0x400
0x40000800 TIM4 size 0x400
0x40000C00 TIM5 size 0x400
0x40001000 TIM6 size 0x400 — Basic timer
0x40001400 TIM7 size 0x400
0x40002800 RTC size 0x400 — Real time clock
0x40002C00 WWDG size 0x400 — Window watchdog
0x40003000 IWDG size 0x400 — Independent watchdog
0x40003800 SPI2 size 0x400
0x40003C00 SPI3 size 0x400
0x40004400 USART2 size 0x400
0x40004800 USART3 size 0x400
0x40004C00 UART4 size 0x400 — Universal asynchronous receiver transmitter
0x40005000 UART5 size 0x400 — Universal asynchronous receiver transmitter
0x40005400 I2C1 size 0x400 — Inter integrated circuit
0x40005800 I2C2 size 0x400
0x40006400 CAN1 size 0x400
0x40006800 CAN2 size 0x400 — Controller area network
0x40006C04 BKP size 0x400 — Backup registers
0x40007000 PWR size 0x400 — Power control
0x40007400 DAC size 0x400 — Digital to analog converter
0x40010000 AFIO size 0x400 — Alternate function I/O
0x40010400 EXTI size 0x400
0x40010800 GPIOA size 0x400 — General purpose I/O
0x40010C00 GPIOB size 0x400
0x40011000 GPIOC size 0x400
0x40011400 GPIOD size 0x400
0x40011800 GPIOE size 0x400
0x40012400 ADC1 size 0x400 — Analog to digital converter
0x40012800 ADC2 size 0x400 — Analog to digital converter
0x40012C00 TIM1 size 0x400 — Advanced timer
0x40013000 SPI1 size 0x400 — Serial peripheral interface
0x40013800 USART1 size 0x400 — Universal synchronous asynchronous receiver transmitter
0x40020000 DMA1 size 0x400 — DMA controller
0x40020400 DMA2 size 0x400
0x40021000 RCC size 0x400 — Reset and clock control
0x40022000 FLASH size 0x400
0x40023000 CRC size 0x400 — CRC calculation unit
0x40028000 ETHERNET_MAC size 0x400 — Ethernet: media access control
0x40028100 ETHERNET_MMC size 0x400 — Ethernet: MAC management counters
0x40028700 ETHERNET_PTP size 0x400 — Ethernet: Precision time protocol
0x40029000 ETHERNET_DMA size 0x400 — Ethernet: DMA controller operation
0x50000000 USB_OTG_GLOBAL size 0x400 — USB on the go full speed
0x50000400 USB_OTG_HOST size 0x400 — USB on the go full speed
0x50000800 USB_OTG_DEVICE size 0x400 — USB on the go full speed
0x50000E00 USB_OTG_PWRCLK size 0x400 — USB on the go full speed
0xE000E000 NVIC size 0x1001 — Nested Vectored Interrupt Controller
0xE0042000 DBG size 0x400 — Debug support

## Interrupts
0 WWDG_IRQ (WWDG) — Window Watchdog interrupt
1 PVD_IRQ (PWR) — PVD through EXTI line detection interrupt
2 TAMPER_IRQ (EXTI) — Tamper interrupt
3 RTC_IRQ (RTC) — RTC global interrupt
4 FLASH_IRQ (FLASH) — Flash global interrupt
5 RCC_IRQ (RCC) — RCC global interrupt
6 EXTI0_IRQ (EXTI) — EXTI Line0 interrupt
7 EXTI1_IRQ (EXTI) — EXTI Line1 interrupt
8 EXTI2_IRQ (EXTI) — EXTI Line2 interrupt
9 EXTI3_IRQ (EXTI) — EXTI Line3 interrupt
10 EXTI4_IRQ (EXTI) — EXTI Line4 interrupt
11 DMA1_Channel1_IRQ (DMA1) — DMA1 Channel1 global interrupt
12 DMA1_Channel2_IRQ (DMA1) — DMA1 Channel2 global interrupt
13 DMA1_Channel3_IRQ (DMA1) — DMA1 Channel3 global interrupt
14 DMA1_Channel4_IRQ (DMA1) — DMA1 Channel4 global interrupt
15 DMA1_Channel5_IRQ (DMA1) — DMA1 Channel5 global interrupt
16 DMA1_Channel6_IRQ (DMA1) — DMA1 Channel6 global interrupt
17 DMA1_Channel7_IRQ (DMA1) — DMA1 Channel7 global interrupt
18 ADC_IRQ (ADC1, ADC2) — ADC1 global interrupt
19 CAN1_TX_IRQ (CAN1) — CAN1 TX interrupts
20 CAN1_RX0_IRQ (CAN1) — CAN1 RX0 interrupts
21 CAN1_RX1_IRQ (CAN1) — CAN1 RX1 interrupts
22 CAN1_SCE_IRQ (CAN1) — CAN1 SCE interrupt
23 EXTI9_5_IRQ (EXTI) — EXTI Line[9:5] interrupts
24 TIM1_BRK_IRQ (TIM1) — TIM1 Break interrupt
25 TIM1_UP_IRQ (TIM1) — TIM1 Update interrupt
26 TIM1_TRG_COM_IRQ (TIM1) — TIM1 Trigger and Commutation interrupts
27 TIM1_CC_IRQ (TIM1) — TIM1 Capture Compare interrupt
28 TIM2_IRQ (TIM2) — TIM2 global interrupt
29 TIM3_IRQ (TIM3) — TIM3 global interrupt
30 TIM4_IRQ (TIM4) — TIM4 global interrupt
31 I2C1_EV_IRQ (I2C1) — I2C1 event interrupt
32 I2C1_ER_IRQ (I2C1) — I2C1 error interrupt
33 I2C2_EV_IRQ (I2C2) — I2C2 event interrupt
34 I2C2_ER_IRQ (I2C2) — I2C2 error interrupt
35 SPI1_IRQ (SPI1) — SPI1 global interrupt
36 SPI2_IRQ (SPI2) — SPI2 global interrupt
37 USART1_IRQ (USART1) — USART1 global interrupt
38 USART2_IRQ (USART2) — USART2 global interrupt
39 USART3_IRQ (USART3) — USART3 global interrupt
40 EXTI15_10_IRQ (EXTI) — EXTI Line[15:10] interrupts
41 RTCAlarm_IRQ (RTC) — RTC Alarms through EXTI line interrupt
50 TIM5_IRQ (TIM5) — TIM5 global interrupt
51 SPI3_IRQ (SPI3) — SPI3 global interrupt
52 UART4_IRQ (UART4) — UART4 global interrupt
53 UART5_IRQ (UART5) — UART5 global interrupt
54 TIM6_IRQ (TIM6) — TIM6 global interrupt
55 TIM7_IRQ (TIM7) — TIM7 global interrupt
56 DMA2_Channel1_IRQ (DMA2) — DMA2 Channel1 global interrupt
57 DMA2_Channel2_IRQ (DMA2) — DMA2 Channel2 global interrupt
58 DMA2_Channel3_IRQ (DMA2) — DMA2 Channel3 global interrupt
59 DMA2_Channel4_IRQ (DMA2) — DMA2 Channel4 global interrupt
60 DMA2_Channel5_IRQ (DMA2) — DMA2 Channel5 global interrupt
61 ETH_IRQ (ETHERNET_MAC) — Ethernet global interrupt
62 ETH_WKUP (ETHERNET_MAC) — Ethernet Wakeup through EXTI line interrupt
63 CAN2_TX_IRQ (CAN2) — CAN2 TX interrupts
64 CAN2_RX0_IRQ (CAN2) — CAN2 RX0 interrupts
65 CAN2_RX1_IRQ (CAN2) — CAN2 RX1 interrupts
66 CAN2_SCE_IRQ (CAN2) — CAN2 SCE interrupt
67 OTG_FS_IRQ (USB_OTG_GLOBAL) — USB On The Go FS global interrupt
